## conf/distro/blog-distro.conf
```bitbake
MAINTAINER = "xxxx <xxxx@yyyy.com>"

require conf/distro/poky.conf

DISTRO = "blog-distro"
DISTRO_NAME = "blog distro"
DISTRO_VERSION = "1.0"
DISTRO_CODENAME = "blog"
SDK_VENDOR = "-blog-distro"
SDK_VERSION = "sdkversion"

#Remove unneeded features
DISTRO_FEATURES_remove += "ext2 pcmcia pci 3g x11 opengl wayland nfc bluetooth alsa"
```

## conf/machine/raspberrypi3-custom.conf
```bitbake
#@TYPE: Blog Custom Machine
#@NAME: Blog Custom Machine based on RaspberryPi 3 Development Board (32bit)
#@DESCRIPTION: Machine configuration for Blog Custom Machine

MACHINEOVERRIDES =. "raspberrypi3:"

DEFAULTTUNE ?= "cortexa7thf-neon-vfpv4"
require conf/machine/include/tune-cortexa7.inc
include conf/machine/include/rpi-base.inc

MACHINE_EXTRA_RRECOMMENDS += "\
    linux-firmware-rpidistro-bcm43430 \
    linux-firmware-rpidistro-bcm43455 \
    bluez-firmware-rpidistro-bcm43430a1-hcd \
    bluez-firmware-rpidistro-bcm4345c0-hcd \
"

PREFERRED_VERSION_linux-raspberrypi ?= "5.4.%"

SDIMG_KERNELIMAGE ?= "kernel7.img"
UBOOT_MACHINE = "rpi_3_32b_config"
SERIAL_CONSOLES ?= "115200;ttyS0"

ARMSTUB ?= "armstub7.bin"

ENABLE_UART = "1"

RPI_KERNEL_DEVICETREE_OVERLAYS_remove += "\
    overlays/pi3-disable-bt.dtbo \
    overlays/pi3-miniuart-bt.dtbo \
"
```
